//This example drives a robot in left and right arcs, driving in an overall wiggly course.
//  It demonstrates the variable control abilities. When used with a RedBot chassis,
//  each turn is about 90 degrees per drive.
//
//  Pin 8 can be grounded to disable motor movement, for debugging.

#include <Arduino.h>
#include <stdint.h>
#include "SCMD.h"
#include "SCMD_config.h" //Contains #defines for common SCMD register names and values
#include "Wire.h"
#include <SparkFun_Qwiic_Button.h>
#define OLED_RESET -3
SCMD myMotorDriver; //This creates the main object of one motor driver and connected slaves.
QwiicButton button;
#include <SPI.h>
#include <Wire.h>
#include <Adafruit_GFX.h>
#include <Adafruit_SSD1306.h>

#define SCREEN_WIDTH 128 // OLED display width, in pixels
#define SCREEN_HEIGHT 64 // OLED display height, in pixels

// Declaration for an SSD1306 display connected to I2C (SDA, SCL pins)
// Reset pin # (or -1 if sharing Arduino reset pin)
Adafruit_SSD1306 display(SCREEN_WIDTH, SCREEN_HEIGHT, &Wire, OLED_RESET);

#define LEFT_MOTOR 0
#define RIGHT_MOTOR 1

int brightness = 100; //Button brightness

//  putting in the bitmap for each image 1-6 is the tank moving its turret up and down. 7-10 is a loading symbol
const unsigned char myBitmap1 [] PROGMEM = {  // 'sad, 128x64px
  // 'happy, 128x64px
  0x00, 0x00, 0x00, 0x00, 0x00, 0x00, 0x00, 0x00, 0x00, 0x00, 0x00, 0x00, 0x00, 0x00, 0x00, 0x00, 
  0x00, 0x00, 0x00, 0x00, 0x00, 0x00, 0x00, 0x00, 0x00, 0x00, 0x00, 0x00, 0x00, 0x00, 0x00, 0x00, 
  0x00, 0x00, 0x00, 0x00, 0x00, 0x00, 0x00, 0x00, 0x00, 0x00, 0x00, 0x00, 0x00, 0x00, 0x00, 0x00, 
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  0x00, 0x00, 0x00, 0x00, 0x00, 0x00, 0x00, 0x00, 0x00, 0x00, 0x00, 0x00, 0x00, 0x00, 0x00, 0x00
};
void setup()
{
  Serial.begin(9600);
  display.begin(SSD1306_SWITCHCAPVCC, 0x3D);          //Loading display
  display.clearDisplay();                             //for Clearing the display
  display.drawBitmap(0, 0, myBitmap1, 128, 64, WHITE); //Drawing the bitmap
  display.display();
  Serial.begin(9600);

  // SSD1306_SWITCHCAPVCC = generate display voltage from 3.3V internally
  if (!display.begin(SSD1306_SWITCHCAPVCC, 0x3D)) { // Address 0x3D for 128x64
    Serial.println(F("SSD1306 allocation failed"));
    for (;;); // Don't proceed, loop forever
  }
  Serial.println("All done!");
  pinMode(8, INPUT_PULLUP); //Use to halt motor movement (ground)


  Serial.println("Starting sketch.");

  //***** Configure the Motor Driver's Settings *****//
  //  .commInter face is I2C_MODE
  myMotorDriver.settings.commInterface = I2C_MODE;

  //  set address if I2C configuration selected with the config jumpers
  myMotorDriver.settings.I2CAddress = 0x5D; //config pattern is "1000" (default) on board for address 0x5D

  //  set chip select if SPI selected with the config jumpers
  myMotorDriver.settings.chipSelectPin = 10;

  //*****initialize the driver get wait for idle*****//
  while ( myMotorDriver.begin() != 0xA9 ) //Wait until a valid ID word is returned
  {
    Serial.println( "ID mismatch, trying again" );
    delay(500);
  }
  Serial.println( "ID matches 0xA9" );

  //  Check to make sure the driver is done looking for slaves before beginning
  Serial.print("Waiting for enumeration...");
  while ( myMotorDriver.ready() == false );
  Serial.println("Done.");
  Serial.println();

  //*****Set application settings and enable driver*****//

  //Uncomment code for motor 0 inversion
  //while( myMotorDriver.busy() );
  //myMotorDriver.inversionMode(0, 1); //invert motor 0

  //Uncomment code for motor 1 inversion
  while ( myMotorDriver.busy() ); //Waits until the SCMD is available.
  myMotorDriver.inversionMode(1, 1); //invert motor 1

  while ( myMotorDriver.busy() );
  myMotorDriver.enable(); //Enables the output driver hardware
  Serial.println("Qwiic button examples");
  Wire.begin(); //Join I2C bus

  //check if button will acknowledge over I2C
  if (button.begin() == false) {
    Serial.println("Device did not acknowledge! Freezing.");
    while (1);
  }
  Serial.println("Button acknowledged.");
  myMotorDriver.setDrive( LEFT_MOTOR, 1, 0);
  myMotorDriver.setDrive( RIGHT_MOTOR, 1, 0);

}

void loop()
{
  //Check whether the button is pressed in order to start the robot
  if (button.isPressed() == true) {
    myMotorDriver.setDrive( LEFT_MOTOR, 1, 40);
    myMotorDriver.setDrive( RIGHT_MOTOR, 1, 40);

    for (int i = 0; i < 4; i++) {    //Loop the action 4 times
      delay(2000);                  

      myMotorDriver.setDrive(LEFT_MOTOR, 1, 80);     //Forward
      myMotorDriver.setDrive(RIGHT_MOTOR, 1, 80);
      delay(1500);
      myMotorDriver.setDrive(LEFT_MOTOR, 1, 100);    //Right
      myMotorDriver.setDrive(RIGHT_MOTOR, 1, 0);
      delay(800);
      myMotorDriver.setDrive(LEFT_MOTOR, 1, 80);     //Forward
      myMotorDriver.setDrive(RIGHT_MOTOR, 1, 80);
      delay(1500);
      myMotorDriver.setDrive(LEFT_MOTOR, 1, 0);      //Left
      myMotorDriver.setDrive(RIGHT_MOTOR, 1, 100);
      delay(800);
      myMotorDriver.setDrive(LEFT_MOTOR, 0, 80);     //Backward
      myMotorDriver.setDrive(RIGHT_MOTOR, 0, 80);
      delay(1500);
      myMotorDriver.setDrive(LEFT_MOTOR, 1, 100);    //Right
      myMotorDriver.setDrive(RIGHT_MOTOR, 1, 0);
      delay(800);
      myMotorDriver.setDrive(LEFT_MOTOR, 0, 80);     //Backward
      myMotorDriver.setDrive(RIGHT_MOTOR, 0, 80);
      delay(1500);
      myMotorDriver.setDrive(LEFT_MOTOR, 1, 0);      //Left
      myMotorDriver.setDrive(RIGHT_MOTOR, 1, 100);
      delay(800);
    }
  }

  myMotorDriver.setDrive( LEFT_MOTOR, 1, 0);
  myMotorDriver.setDrive( RIGHT_MOTOR, 1, 0);
  display.clearDisplay();




}
